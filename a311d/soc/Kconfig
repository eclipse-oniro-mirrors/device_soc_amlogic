## a311d/soc/Kconfig
```kconfig
# SPDX-License-Identifier: GPL-2.0
menu "Vendor Drivers"

source "vendor/amlogic/Kconfig"

source "vendor/drivers/Kconfig"

endmenu
```

## a311d/soc/amlogic/Kconfig
```kconfig
#
# Amlogic driver configuration
#
config AMLOGIC_DRIVER
	bool "Amlogic Peripheral drivers"
	default n
	help
		this option is provided for control amlogic
		drivers, if you want to use amlogic driver
		please open it

config AMLOGIC_MODIFY
	bool "Amlogic modify for kernel code"
	default n
	help
		this option is set up for AMLOGIC modify of
		standard kernel source code. All modify of kernel
		standard code should be wrapped by this config

if AMLOGIC_DRIVER
menu "Amlogic Device Drivers"
source "vendor/amlogic/codecs/Kconfig"
source "vendor/amlogic/uart/Kconfig"
source "vendor/amlogic/unifykey/Kconfig"
source "vendor/amlogic/iomap/Kconfig"
source "vendor/amlogic/phy/Kconfig"
source "vendor/amlogic/pm/Kconfig"
source "vendor/amlogic/secmon/Kconfig"
source "vendor/amlogic/reboot/Kconfig"
source "vendor/amlogic/cpu_version/Kconfig"
source "vendor/amlogic/media/Kconfig"
source "vendor/amlogic/ge2d/Kconfig"
source "vendor/amlogic/canvas/Kconfig"
source "vendor/amlogic/media/common/codec_mm/Kconfig"
source "vendor/amlogic/input/Kconfig"
endmenu
endif
```

## a311d/soc/amlogic/codecs/Kconfig
```kconfig
# SPDX-License-Identifier: GPL-2.0-only

config SND_SOC_ES7243
	tristate "Everest Semi ES7243 CODEC"
	depends on I2C
```

## a311d/soc/amlogic/input/Kconfig
```kconfig
#
# Amlogic Input Module
#
menu "Amlogic Input Module"
config  AMLOGIC_INPUT
	bool "Amlogic Input Module"
	default n
	help
		Select to enable Input.
endmenu
```

## a311d/soc/amlogic/media/Kconfig
```kconfig
#
# Amlogic Media Module
#
menu "Amlogic Media Module"
config  AMLOGIC_MEDIA
	bool "Amlogic Media Module"
	default n
	help
		Select to enable Media.
endmenu
```

## a311d/soc/amlogic/phy/Kconfig
```kconfig
config PHY_MESON_G12A_MIPI_DPHY_ANALOG
	tristate "Meson G12A MIPI Analog DPHY driver"
	default ARCH_MESON
	depends on OF && (ARCH_MESON || COMPILE_TEST)
	select GENERIC_PHY
	select REGMAP_MMIO
	select GENERIC_PHY_MIPI_DPHY
	help
	  Enable this to support the Meson MIPI Analog DPHY found in Meson G12A
	  SoCs.
	  If unsure, say N.

config PHY_MESON_AXG_MIPI_DPHY
	tristate "Meson AXG MIPI DPHY driver"
	default ARCH_MESON
	depends on OF && (ARCH_MESON || COMPILE_TEST)
	select GENERIC_PHY
	select REGMAP_MMIO
	select GENERIC_PHY_MIPI_DPHY
	help
	  Enable this to support the Meson MIPI DPHY found in Meson AXG
	  SoCs.
	  If unsure, say N.
```

## a311d/soc/amlogic/pm/Kconfig
```kconfig
# SPDX-License-Identifier: GPL-2.0-only
#
# Amlogic Power Management
#

config MESON_GX_PM
	bool
	default ARCH_MESON if ARM64
	help
	  Say y here to enable the Amlogic GX SoC Power Management
```

## a311d/soc/amlogic/reboot/Kconfig
```kconfig
# Amlogic POWER OFF
config AMLOGIC_REBOOT
	bool "Amlogic Board level reboot or power off"
	default n
    help
		This is the Amlogic
		Board reboot
		or poweroff
		driver.

config AMLOGIC_GX_REBOOT
	bool "Amlogic reboot gx"
	depends on AMLOGIC_REBOOT
	default n
    help
		This is the Amlogic GX reboot driver.
```

## a311d/soc/amlogic/uart/Kconfig
```kconfig
#
# Amlogic driver configuration
#

config AMLOGIC_UART
	bool "Serial support"
	select SERIAL_CORE
	select SERIAL_EARLYCON
	default n
    help
	Add support for the Amlogic serial port.
	this config only ctrl in makefile
	this config do not in meson_uart.c
	this config add

config AMLOGIC_SERIAL_MESON_CONSOLE
	bool "Console on Amlogic Serial port"
	select SERIAL_CORE_CONSOLE
	default n
	help
		Support for running a console on the Amlogic serial
		this config is only
		used in meson_uart.c
		so so
```
